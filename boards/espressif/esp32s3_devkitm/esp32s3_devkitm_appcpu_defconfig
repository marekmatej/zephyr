## boards/espressif/esp32s3_devkitm/esp32s3_devkitm_appcpu_defconfig
```kconfig
# SPDX-License-Identifier: Apache-2.0

CONFIG_MAIN_STACK_SIZE=4092
#CONFIG_CLOCK_CONTROL=y

#CONFIG_CONSOLE=y
#CONFIG_SERIAL=y
#CONFIG_UART_CONSOLE=y
```

## boards/others/esp32_uwb/Kconfig
```kconfig
# Copyright (c) 2025 Marek Matej 
# SPDX-License-Identifier: Apache-2.0

config HEAP_MEM_POOL_ADD_SIZE_BOARD
	int
	default 4096 if BOARD_ESP32_UWB_ESP32_PROCPU
	default 1024 if BOARD_ESP32_UWB_ESP32_APPCPU
```

## boards/others/esp32_uwb/Kconfig.esp32_uwb
```kconfig
# Copyright (c) 2025 Marek Matej 
# SPDX-License-Identifier: Apache-2.0

config BOARD_ESP32_UWB
	select SOC_ESP32_WROVER_E_N16R8
	select SOC_ESP32_PROCPU if BOARD_ESP32_UWB_ESP32_PROCPU
	select SOC_ESP32_APPCPU if BOARD_ESP32_UWB_ESP32_APPCPU
	select ESP32_USE_UNSUPPORTED_REVISION
```

## boards/others/esp32_uwb/board.yml
```yaml
board:
  name: esp32_uwb
  full_name: ESP32-DW1000-UWB
  vendor: others
  socs:
  - name: esp32
```

## boards/riscv/esp32c6_devkitc/Kconfig.board
```kconfig
# ESP32C6 devkitc board configuration

# Copyright (c) 2023 Espressif Systems (Shanghai) Co., Ltd.
# SPDX-License-Identifier: Apache-2.0

config BOARD_ESP32C6_DEVKITC
	bool "ESP32-C6-DevKitC Board"
	depends on SOC_SERIES_ESP32C6
```

## boards/riscv/esp32c6_devkitc/Kconfig.defconfig
```kconfig
# ESP32C6 devkitc board configuration

# Copyright (c) 2023 Espressif Systems (Shanghai) Co., Ltd.
# SPDX-License-Identifier: Apache-2.0

config BOARD
	default "esp32c6_devkitc"
	depends on BOARD_ESP32C6_DEVKITC

config HEAP_MEM_POOL_SIZE
	default 98304 if WIFI
	default 40960 if BT
	default 4096
```

## boards/riscv/esp32c6_devkitc/esp32c6_devkitc_defconfig
```kconfig
# SPDX-License-Identifier: Apache-2.0

CONFIG_BOARD_ESP32C6_DEVKITC=y
CONFIG_SOC_SERIES_ESP32C6=y
CONFIG_MAIN_STACK_SIZE=2048
CONFIG_CONSOLE=y
CONFIG_SERIAL=y
CONFIG_UART_CONSOLE=y
CONFIG_GPIO=y
```

## boards/xtensa/esp32_uwb/Kconfig.board
```kconfig
# ESP32 board configuration

# Copyright (c) 2023 Espressif Systems (Shanghai) Co., Ltd.
# SPDX-License-Identifier: Apache-2.0

config BOARD_ESP32_UWB
	bool "ESP32 Board with DW1000 UWB chip"
	depends on SOC_ESP32
```

## soc/riscv/espressif_esp32/esp32c6/Kconfig.series
```kconfig
# Copyright (c) 2023 Espressif Systems (Shanghai) Co., Ltd.
# SPDX-License-Identifier: Apache-2.0

config SOC_SERIES_ESP32C6
	bool "ESP32C6"
	select RISCV
	select RISCV_GP
	select DYNAMIC_INTERRUPTS
	select CLOCK_CONTROL
	select PINCTRL
	select SOC_FAMILY_ESP32
	select XIP if !MCUBOOT
	select HAS_ESPRESSIF_HAL
	select RISCV_ISA_RV32I
	select RISCV_ISA_EXT_M
	select RISCV_ISA_EXT_C
	select RISCV_ISA_EXT_ZICSR
	help
	  Enable support for Espressif ESP32-C6
```

## soc/riscv/espressif_esp32/esp32c6/Kconfig.soc
```kconfig
# Copyright (c) 2023 Espressif Systems (Shanghai) Co., Ltd.
# SPDX-License-Identifier: Apache-2.0

if SOC_SERIES_ESP32C6

config IDF_TARGET_ESP32C6
	bool "ESP32C6 as target board"
	default y

choice SOC_PART_NUMBER
	prompt "ESP32-C6 SOC Selection"
	depends on SOC_SERIES_ESP32C6

	config SOC_ESP32_C6_WROOM_1U_N4
		bool "ESP32-C6-WROOM-1U-N4"
	config SOC_ESP32_C6_WROOM_1U_N8
		bool "ESP32-C6-WROOM-1U-N8"

endchoice # SOC_PART_NUMBER

config ESP_SYSTEM_RTC_EXT_XTAL
	bool

config ESP_SYSTEM_RTC_EXT_OSC
	bool

choice ESP32_RTC_CLK_SRC
	prompt "RTC clock source"
	default ESP32_RTC_CLK_SRC_INT_RC
	help
	  Choose which clock is used as RTC clock source.

config ESP32_RTC_CLK_SRC_INT_RC
	bool "Internal 136kHz RC oscillator"

config ESP32_RTC_CLK_SRC_EXT_CRYS
	bool "External 32kHz crystal"
	select ESP_SYSTEM_RTC_EXT_XTAL

config ESP32_RTC_CLK_SRC_EXT_OSC
	bool "External 32kHz oscillator at 32K_XP pin"
	select ESP_SYSTEM_RTC_EXT_OSC

config RTC_CLK_SRC_INT_RC32K
	bool "Internal 32kHz RC oscillator"

endchoice

config ESP32_RTC_CLK_CAL_CYCLES
	int "Number of cycles for RTC_SLOW_CLK calibration"
	default 3000 if ESP32_RTC_CLK_SRC_EXT_CRYS || ESP32_RTC_CLK_SRC_EXT_OSC || ESP32_RTC_CLK_SRC_INT_8MD256
	default 1024 if ESP32_RTC_CLK_SRC_INT_RC
	range 0 27000 if ESP32_RTC_CLK_SRC_EXT_CRYS || ESP32_RTC_CLK_SRC_EXT_OSC || ESP32_RTC_CLK_SRC_INT_8MD256
	range 0 32766 if ESP32_RTC_CLK_SRC_INT_RC
	help
	  When the startup code initializes RTC_SLOW_CLK, it can perform
	  calibration by comparing the RTC_SLOW_CLK frequency with main XTAL
	  frequency. This option sets the number of RTC_SLOW_CLK cycles measured
	  by the calibration routine. Higher numbers increase calibration
	  precision, which may be important for applications which spend a lot of
	  time in deep sleep. Lower numbers reduce startup time.

	  When this option is set to 0, clock calibration will not be performed at
	  startup, and approximate clock frequencies will be assumed:

	  - 150000 Hz if internal RC oscillator is used as clock source. For this use value 1024.
	  - 32768 Hz if the 32k crystal oscillator is used. For this use value 3000 or more.
	    In case more value will help improve the definition of the launch of the crystal.
	    If the crystal could not start, it will be switched to internal RC.
endif
```
